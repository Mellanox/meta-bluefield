## conf/bblayers.conf.sample
```bitbake
# POKY_BBLAYERS_CONF_VERSION is increased each time build/conf/bblayers.conf
# changes incompatibly
POKY_BBLAYERS_CONF_VERSION = "2"

BBPATH = "${TOPDIR}"
BBFILES ?= ""

BBLAYERS ?= " \
  ${TOPDIR}/layers/poky/meta \
  ${TOPDIR}/layers/poky/meta-poky \
  ${TOPDIR}/layers/poky/meta-yocto-bsp \
  ${TOPDIR}/layers/meta-openembedded/meta-oe \
  ${TOPDIR}/layers/meta-openembedded/meta-python \
  ${TOPDIR}/layers/meta-openembedded/meta-networking \
  ${TOPDIR}/layers/meta-openembedded/meta-filesystems \
  ${TOPDIR}/layers/meta-openembedded/meta-perl \
  ${TOPDIR}/layers/meta-openembedded/meta-initramfs \
  ${TOPDIR}/layers/meta-openembedded/meta-webserver \
  ${TOPDIR}/layers/meta-virtualization \
  ${TOPDIR}/layers/meta-linaro/meta-linaro \
  ${TOPDIR}/layers/meta-linaro/meta-linaro-integration \
  ${TOPDIR}/layers/meta-secure-core/meta \
  ${TOPDIR}/layers/meta-secure-core/meta-efi-secure-boot \
  ${TOPDIR}/layers/meta-secure-core/meta-signing-key \
  ${TOPDIR}/layers/meta-cloud-services \
  ${TOPDIR}/layers/meta-cloud-services/meta-openstack \
  ${TOPDIR}/layers/meta-bluefield \
  "
```

## conf/layer.conf
```bitbake
LAYERSERIES_COMPAT_bluefield = "warrior"

# We have a conf and classes directory, add to BBPATH
BBPATH =. "${LAYERDIR}:"

# Add recipes-* directories and classes to BBFILES
BBFILES += "${LAYERDIR}/recipes-*/*/*.bb \
	${LAYERDIR}/recipes-*/*/*.bbappend \
	${LAYERDIR}/classes/*.bbclass"

BBFILE_COLLECTIONS += "bluefield"
BBFILE_PATTERN_bluefield = "^${LAYERDIR}/"
BBFILE_PRIORITY_bluefield = "42"
```

## conf/machine/bluefield.conf
```bitbake
#@TYPE: Machine
#@NAME: BlueField board or system

#@DESCRIPTION: Machine configuration for boards or systems based on the Mellanox BlueField chip.

# require conf/machine/include/arm/arch-arm64.inc

# Better performance under certain use cases but may not be portable
# between Arm chips.
# Basically this adds "-march=armv8-a+simd+crc+crypto -mcpu=cortex-a72"
# to your gcc options.
require conf/machine/include/tune-cortexa72.inc

# Add some support for qemu features as well.
EXTRA_IMAGEDEPENDS += "qemu-native qemu-helper-native"
KERNEL_IMAGETYPE = "Image"
SERIAL_CONSOLES = "115200;ttyAMA0 115200;ttyAMA1 115200;hvc0"
COMPATIBLE_MACHINE_bluefield = "bluefield"

# enable /usr/lib64
BASELIB_bluefield = "lib64"
```
